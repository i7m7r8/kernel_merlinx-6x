## drivers/clk/mediatek/Kconfig
```kconfig
config COMMON_CLK_MT6769_TOPCKGEN
	tristate "Clock driver for MediaTek MT6768/MT6769 topckgen"
	depends on ARCH_MEDIATEK || COMPILE_TEST
	select COMMON_CLK_MEDIATEK
	default ARCH_MEDIATEK
	help
	  This driver supports MediaTek MT6768/MT6769 top clock generator.

config COMMON_CLK_MT6769_APMIXED
	tristate "Clock driver for MediaTek MT6768/MT6769 apmixedsys"
	depends on COMMON_CLK_MT6769_TOPCKGEN
	help
	  This driver supports MediaTek MT6768/MT6769 apmixed PLL clocks.

config COMMON_CLK_MT6769_INFRA
	tristate "Clock driver for MediaTek MT6768/MT6769 infracfg"
	depends on COMMON_CLK_MT6769_TOPCKGEN
	help
	  This driver supports MediaTek MT6768/MT6769 infrastructure clocks.

config COMMON_CLK_MT6779_MM
	tristate "Clock driver for MediaTek MT6779 multimedia subsystem"
	depends on ARCH_MEDIATEK || COMPILE_TEST
	help
	  This driver supports MediaTek MT6779 multimedia clock gates.

config COMMON_CLK_MT6779_MFG
	tristate "Clock driver for MediaTek MT6779 MFG (GPU)"
	depends on COMMON_CLK_MT6779_MM || COMPILE_TEST
	help
	  This driver supports MediaTek MT6779 MFG (GPU) clock gates.
```

## drivers/pinctrl/mediatek/Kconfig
```kconfig
config PINCTRL_MT6768
	bool "MediaTek MT6768/MT6769 pin control"
	depends on ARM64 || COMPILE_TEST
	depends on ARCH_MEDIATEK
	default ARM64 && ARCH_MEDIATEK
	select PINCTRL_MTK
	help
	  Say Y here to enable the pin controller for MediaTek MT6768/MT6769
	  SoCs. This enables GPIO and pinmux support for devices like the
	  Redmi Note 9 (merlin).
```
